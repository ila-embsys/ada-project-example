## app/Kconfig
```kconfig
# SPDX-License-Identifier: Apache-2.0

mainmenu "ADA_TEST"

# Your application configuration options go here

config ADA_TEST
    default y
    bool
    select CPLUSPLUS
    select ADA_GNAT_RTS

# Sources Kconfig.zephyr in the Zephyr root directory.
#
# Note: All 'source' statements work relative to the Zephyr root directory (due
# to the $srctree environment variable being set to $ZEPHYR_BASE). If you want
# to 'source' relative to the current Kconfig file instead, use 'rsource' (or a
# path relative to the Zephyr root).
source "Kconfig.zephyr"
```

## app/west.yml
```yaml
manifest:
  remotes:
    - name: upstream
      url-base: https://github.com/zephyrproject-rtos

    - name: zephyr-ada
      url-base: https://github.com/zephyr-ada

    - name: thirdpin
      url-base: https://github.com/thirdpin

  # Please add items below based on alphabetical order
  projects:
    - name: Zephyr-CMake-Helpers
      remote: thirdpin
      revision: v.1.2.1
      path: modules/zephyr-cmake-helpers

    - name: cmsis
      remote: upstream
      revision: 5f86244bad4ad5a590e084f0e72ba7a1416c2edf
      path: modules/hal/cmsis

    - name: hal_stm32
      remote: upstream
      revision: c87358a3e9b99e0f8f18816f1a74777fe80d1ab6
      path: modules/hal/stm32

    - name: segger
      remote: upstream
      revision: 3a52ab222133193802d3c3b4d21730b9b1f1d2f6
      path: modules/debug/segger

    - name: zephyr-ada-gnat-rts
      remote: zephyr-ada
      revision: 1f9c0ce082c4046859fc8b0b62194b5fd397cd40 
      path: modules/gnat

    - name: zephyr
      remote: zephyr-ada
      revision: v3.1.0-ada-branch
      path: zephyr
      west-commands: scripts/west-commands.yml

  self:
    path: app
```
